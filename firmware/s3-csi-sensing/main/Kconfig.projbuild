## firmware/s3-csi-sensing/main/Kconfig.projbuild
```kconfig
menu "WiFi DensePosition Configuration"

    config DENSEPOSITION_WIFI_SSID
        string "Wi-Fi SSID"
        default ""

    config DENSEPOSITION_WIFI_PASSWORD
        string "Wi-Fi password"
        default ""

endmenu
```

## firmware/s3-csi-sensing/sdkconfig.defaults
```kconfig
CONFIG_ESP_WIFI_CSI_ENABLED=y
CONFIG_ESPTOOLPY_FLASHSIZE_8MB=y
CONFIG_ESP_CONSOLE_USB_SERIAL_JTAG=y
```
